## drivers/input/touchscreen/oplus_touchscreen/Focal/ft3658u/Kconfig
```kconfig
config TOUCHPANEL_FOCAL_FT3658U
	bool "TP Focal_FT3658U IC enable or not for OPLUS"
	---help---
	say Y to enable driver for Touchpanel using Focal FT3658U
```
